## lib/lvgl_gui/Kconfig
```kconfig
# Kconfig file for LVGL GUI Library v1.0.0

menu "LVGL Gui Configuration"

    config LV_CONF_SKIP
        bool "Uncheck this to use custom lv_conf.h"
        default y
    
    config GUI_MENU_TEST
        bool "Test if menuconfig works."
        default y

endmenu
```
